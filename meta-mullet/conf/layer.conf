## meta-mullet/conf/layer.conf
```bitbake
BBPATH .= ":${LAYERDIR}"
BBFILES += "${LAYERDIR}/recipes*/*/*.bb ${LAYERDIR}/recipes*/*/*.bbappend"
BBFILE_COLLECTIONS += "mullet-hybris-layer"
BBFILE_PATTERN_mullet-hybris-layer := "^${LAYERDIR}/"
BBFILE_PRIORITY_mullet-hybris-layer = "7"
LAYERSERIES_COMPAT_mullet-hybris-layer = "kirkstone"
```

## meta-sawfish/conf/machine/sawfish.conf
```bitbake
#@TYPE: Machine
#@NAME: Huawei Watch 2
#@DESCRIPTION: Machine configuration for the Huawei Watch 2

require conf/machine/include/arm/armv7a/tune-cortexa7.inc
DEFAULTTUNE = "armv7vehf-neon"
require conf/machine/include/hybris-watch.inc

MACHINE_DISPLAY_ROUND = "true"
MACHINE_HAS_WLAN = "true"
MACHINE_HAS_SPEAKER = "true"

PREFERRED_VERSION_android = "armv7+oreo"

PREFERRED_PROVIDER_virtual/kernel = "linux-sawfish"
PREFERRED_VERSION_linux = "3.10+oreo"

IMAGE_INSTALL += "sensorfw-hybris-hal-plugins brcm-patchram-plus iproute2 wpa-supplicant underclock android-system-data asteroid-hrm"
```
